## Kconfig.el_common_module
```kconfig
menu "EerieLeap Common"

config EERIE_LEAP_COMMON
    bool "EerieLeap Common Module"
    help
      Add EerieLeap common code.


config EERIE_LEAP_CANBUS
    bool "EerieLeap CANBus"
    help
      Add EerieLeap CANBus.

config EERIE_LEAP_CFB
    bool "EerieLeap CFB"
    help
      Add EerieLeap CFB.

config EERIE_LEAP_DBC
    bool "EerieLeap DBC"
    help
      Add EerieLeap DBC.

config EERIE_LEAP_FS
    bool "EerieLeap FS"
    help
      Add EerieLeap FS.

config EERIE_LEAP_GPIO
    bool "EerieLeap GPIO"
    help
      Add EerieLeap GPIO.

config EERIE_LEAP_LUA_SCRIPT
    bool "EerieLeap Lua Script"
    select LUA
    help
      Add EerieLeap Lua Script.

config EERIE_LEAP_MATH_PARSER
    bool "EerieLeap Math Parser"
    help
      Add EerieLeap Math Parser.

config EERIE_LEAP_MDF
    bool "EerieLeap MDF"
    help
      Add EerieLeap MDF.

config EERIE_LEAP_MODBUS
    bool "EerieLeap Modbus"
    help
      Add EerieLeap Modbus.

config EERIE_LEAP_RANDOM
    bool "EerieLeap Random"
    help
      Add EerieLeap Random.

config EERIE_LEAP_THREADING
    bool "EerieLeap Threading"
    help
      Add EerieLeap Threading.

config EERIE_LEAP_TIME
    bool "EerieLeap Time"
    help
      Add EerieLeap Time.

config EERIE_LEAP_DOMAIN_CANBUS
    bool "EerieLeap CANBus Domain"
    help
      Add EerieLeap CANBus Domain.

module = EERIE_LEAP_COMMON
module-str = eerie_leap_common

source "subsys/logging/Kconfig.template.log_config"
rsource "src/subsys/cdmp/Kconfig.cdmp"

rsource "src/domain/canbus_com_domain/Kconfig.canbus_com_domain"
endmenu
```

## src/configuration/Kconfig.configuration
```kconfig
config EERIE_LEAP_CONFIGURATION
    bool "EerieLeap Configuration"
    help
      Add EerieLeap Configuration.

menu "EerieLeap Configuration config"
    depends on EERIE_LEAP_CONFIGURATION

    config EERIE_LEAP_SD_CARD_USER_CONFIG_DIR
        string "User config directory"
        default "configuration"
endmenu
```

## src/subsys/adc/Kconfig.adc
```kconfig
config EERIE_LEAP_ADC
    bool "EerieLeap ADC"
    help
      Add EerieLeap ADC.

menu "EerieLeap ADC config"
    depends on EERIE_LEAP_ADC

    config EERIE_LEAP_ADC_VOLTAGE_MAX_MV
        int "ADC voltage max"
        default 3100

    config EERIE_LEAP_SENSOR_VOLTAGE_MAX_MV
        int "Sensor voltage max"
        default 5000

    config EERIE_LEAP_ADC_CALIBRATION_SAMPLES_COUNT
        int "ADC calibration samples count"
        default 2048

    config EERIE_LEAP_ADC_CALIBRATION_SAMPLING_RATE_MS
        int "ADC calibration sampling rate ms"
        default 100
endmenu
```

## src/subsys/canbus/Kconfig.canbus
```kconfig
config EERIE_LEAP_CANBUS
    bool "EerieLeap CANBus"
    help
      Add EerieLeap CANBus.

menu "EerieLeap CANBus config"
    depends on EERIE_LEAP_CANBUS

    config EERIE_LEAP_CANBUS_AUTO_DETECT_INTERVAL_MS
        int "Canbus auto detect activity check interval ms"
        default 5000
endmenu
```

## src/subsys/modbus/Kconfig.modbus
```kconfig
config EERIE_LEAP_MODBUS
    bool "EerieLeap Modbus"
    help
      Add EerieLeap Modbus.

menu "EerieLeap Modbus config"
    depends on EERIE_LEAP_MODBUS

    config EERIE_LEAP_MODBUS_BAUD_RATE
        int "Modbus baud rate"
        default 115200

    config EERIE_LEAP_MODBUS_RX_TIMEOUT
        int "Modbus rx timeout"
        default 50000
endmenu
```
